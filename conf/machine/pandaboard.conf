## conf/machine/pandaboard.conf
```bitbake
#@TYPE: Machine
#@NAME: PandaBoard
#@DESCRIPTION: Machine configuration for the http://pandaboard.org/ board

include conf/machine/include/tune-cortexa9.inc

PREFERRED_PROVIDER_virtual/kernel = "linux-omap4"
PREFERRED_PROVIDER_virtual/xserver = "xserver-kdrive"

XSERVER = "xserver-kdrive-fbdev"
KERNEL_IMAGETYPE = "uImage"

# Only has HDMI connector for external screen
GUI_MACHINE_CLASS = "bigscreen"

# Ship all kernel modules till the board support has matured enough
MACHINE_EXTRA_RRECOMMENDS = " kernel-modules"

IMAGE_FSTYPES += "tar.bz2"
#EXTRA_IMAGECMD_jffs2 = "-lnp "
EXTRA_IMAGEDEPENDS += "u-boot-omap4 x-load-omap4"

SERIAL_CONSOLE = "115200 ttyO2"

XLOAD_MACHINE = "omap4430panda_config"
XLOAD_LOAD_ADDRESS = 0x40304350

UBOOT_ENTRYPOINT = "0x80008000"
UBOOT_LOADADDRESS = "0x80008000"

MACHINE_FEATURES = "kernel26 apm usbgadget usbhost ext3 vfat alsa screen touchscreen"
```
